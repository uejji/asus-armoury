## Kconfig
```kconfig
config ASUS_ARMOURY
	tristate "ASUS Armoury (firmware) Driver"
	depends on ACPI_WMI
	depends on ASUS_WMI
	select FW_ATTR_CLASS
	help
	  Say Y here if you have a WMI aware Asus laptop and would like to use the
	  firmware_attributes API to control various settings typically exposed in
	  the ASUS Armoury Crate application available on Windows.

	  To compile this driver as a module, choose M here: the module will
	  be called asus-armoury.
```
